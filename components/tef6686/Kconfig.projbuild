## components/tef6686/Kconfig.projbuild
```kconfig
menu "TEF6686 Configuration"

config TEF_I2C_SDA_PIN
    int "I2C SDA GPIO"
    default 8

config TEF_I2C_SCL_PIN
    int "I2C SCL GPIO"
    default 9

config TEF_I2C_FREQ_HZ
    int "I2C frequency (Hz)"
    default 400000

config TEF_I2C_PORT
    int "I2C port number"
    default 0

config TEF_CHIP_VERSION
    int "Chip version (102 or 205)"
    default 205
    help
        TEF6686 firmware patch version: 102 for V102/p224, 205 for V205/p512.

config TEF_XTAL_TYPE
    int "Crystal type"
    default 0
    help
        0=4MHz, 1=9.216MHz, 2=12MHz, 3=55MHz.

endmenu
```

## components/tuner_frontend/Kconfig.projbuild
```kconfig
menu "Audio Configuration"

config AUDIO_I2S_PORT
    int "I2S port number"
    default 0
    help
        I2S port for audio input from TEF6686.

config AUDIO_BCLK_PIN
    int "I2S BCLK GPIO"
    default 4
    help
        GPIO for I2S BCLK from TEF6686.

config AUDIO_WS_PIN
    int "I2S WS (LRCLK) GPIO"
    default 5
    help
        GPIO for I2S word select from TEF6686.

config AUDIO_DATA_PIN
    int "I2S Data In GPIO"
    default 6
    help
        GPIO for I2S data input from TEF6686.

config AUDIO_SAMPLE_RATE
    int "Audio sample rate (Hz)"
    default 48000
    help
        USB and TEF6686 I2S audio sample rate. TEF6686 supports 44100 and
        48000 Hz; 48000 Hz is the simpler USB full-speed default.

config AUDIO_BITS_PER_SAMPLE
    int "Bits per sample"
    default 16
    help
        Audio bit depth (16 or 24).

config AUDIO_TASK_CORE
    int "Audio task CPU core (-1 = no affinity)"
    default 1
    range -1 1
    help
        CPU core for the I2S to USB audio bridge task. Keep the default on
        core 1 so Wi-Fi/control work on core 0 does not compete with the
        audio hot path.

endmenu

menu "Tuner Defaults"

config TUNER_DEFAULT_VOLUME
    int "Default volume (0-30)"
    default 20
    range 0 30
    help
        Default volume level on startup.

config TUNER_DEFAULT_BAND_FM
    bool "Start in FM band"
    default y
    help
        If enabled, the tuner starts in FM band mode.

endmenu
```

## main/Kconfig.projbuild
```kconfig
menu "USB CDC Configuration"

config USB_CDC_RX_BUF_SIZE
    int "CDC RX buffer size"
    default 256
    help
        Size of the CDC receive buffer.

config USB_CDC_CMD_TASK_STACK
    int "Command task stack size"
    default 4096
    help
        Stack size for the command processing task.

config USB_CDC_CMD_TASK_PRIO
    int "Command task priority"
    default 5
    help
        Priority for the command processing task.

endmenu

menu "WiFi Manager Configuration"

config WIFI_AP_SSID_PREFIX
    string "AP SSID prefix"
    default "TEF6686"
    help
        Prefix for the generated AP SSID. Last 2 bytes of MAC are appended.

config WIFI_AP_PASSWORD
    string "AP password (empty = open)"
    default ""
    help
        Password for AP mode. Leave empty for open network.

config WIFI_AP_CHANNEL
    int "AP channel"
    default 1
    range 1 13

config WIFI_STA_CONNECT_TIMEOUT_MS
    int "STA connect timeout (ms)"
    default 5000
    help
        Time in milliseconds to wait for STA connection before falling back to AP-only.

endmenu
```

## sdkconfig.defaults
```kconfig
# Target
CONFIG_IDF_TARGET="esp32s3"

# Serial flasher
CONFIG_ESPTOOLPY_FLASHSIZE_16MB=y

# Partition table
CONFIG_PARTITION_TABLE_CUSTOM=y
CONFIG_PARTITION_TABLE_CUSTOM_FILENAME="partitions.csv"
CONFIG_PARTITION_TABLE_FILENAME="partitions.csv"

CONFIG_TINYUSB_CDC_ENABLED=y

# I2S
CONFIG_I2S_ENABLE_DEBUG_LOG=n

# FreeRTOS
CONFIG_FREERTOS_HZ=1000

# Main task stack size
CONFIG_ESP_MAIN_TASK_STACK_SIZE=10240

# Wi-Fi
CONFIG_ESP_WIFI_ENABLED=y

# HTTP Server
CONFIG_HTTPD_MAX_REQ_HDR_LEN=1024
CONFIG_HTTPD_MAX_URI_LEN=256

# PSRAM (ESP32-S3 N16R8 has 8MB)
CONFIG_SPIRAM=y
```
